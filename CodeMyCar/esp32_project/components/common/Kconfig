## CodeMyCar/esp32_project/components/common/Kconfig
```kconfig
menu "CodeMyCar Configuration"

    config CMCAR_DEVICE_ID
        string "Device ID"
        default "DEV_1"
        help
            设备唯一标识符，用于 MQTT topic 中区分设备。

    config CMCAR_SYSTEM_READY_TIMEOUT_MS
        int "System ready timeout (ms)"
        default 10000
        range 1000 60000
        help
            所有组件初始化完成的最大等待时间。

endmenu
```

## CodeMyCar/esp32_project/components/mqtt_service/Kconfig
```kconfig
menu "MQTT Configuration"

    config CMCAR_MQTT_BROKER_URL
        string "MQTT Broker URL"
        default "mqtt://192.168.31.119:1883"

    config CMCAR_MQTT_CLIENT_ID
        string "MQTT Client ID"
        default "codemycar_esp32"

    config CMCAR_MQTT_USERNAME
        string "MQTT Username (empty = anonymous)"
        default ""

    config CMCAR_MQTT_PASSWORD
        string "MQTT Password"
        default ""

    config CMCAR_MQTT_KEEPALIVE_SEC
        int "Keepalive interval (seconds)"
        default 60
        range 10 600

    config CMCAR_MQTT_BUFFER_SIZE
        int "MQTT buffer size (bytes)"
        default 2048
        range 512 8192

    config CMCAR_MQTT_RECONNECT_MAX_MS
        int "Max reconnect backoff (ms)"
        default 60000
        range 5000 300000

endmenu
```

## CodeMyCar/esp32_project/components/uart_service/Kconfig
```kconfig
menu "UART Configuration"

    config CMCAR_UART_PORT
        int "UART port number"
        default 1
        range 0 2

    config CMCAR_UART_BAUD_RATE
        int "Baud rate"
        default 115200

    config CMCAR_UART_TX_PIN
        int "TX GPIO number"
        default 4

    config CMCAR_UART_RX_PIN
        int "RX GPIO number"
        default 5

    config CMCAR_UART_RX_BUF_SIZE
        int "UART driver RX buffer size (bytes)"
        default 1024
        range 256 4096

    config CMCAR_UART_TX_BUF_SIZE
        int "UART driver TX buffer size (bytes)"
        default 512
        range 0 4096

    config CMCAR_UART_RINGBUF_SIZE
        int "Raw data ring buffer size (bytes)"
        default 1024
        range 256 4096

    config CMCAR_UART_TX_QUEUE_DEPTH
        int "TX queue depth (frames)"
        default 8
        range 2 32

endmenu
```

## CodeMyCar/esp32_project/components/voice_service/Kconfig
```kconfig
menu "Voice Control"

    choice CMCAR_VOICE_MODE
        prompt "Voice session mode"
        default CMCAR_VOICE_MODE_COMMAND
        help
            COMMAND keeps one utterance per wake and the existing intent path.
            CONVERSATION keeps one WebSocket session open after a wake and lets
            the pyserver drive multi-turn ASR -> LLM -> TTS.
        config CMCAR_VOICE_MODE_COMMAND
            bool "One command per wake (current behavior)"
        config CMCAR_VOICE_MODE_CONVERSATION
            bool "Continuous multi-turn conversation after one wake"
    endchoice

    config CMCAR_VOICE_DENOISE
        bool "Experimental S3 NS during listening (requires A/B validation)"
        depends on IDF_TARGET_ESP32S3
        default n

    config CMCAR_VOICE_QUEUE_FRAMES
        int "Processed PCM queue depth (20ms frames)"
        default 64 if IDF_TARGET_ESP32S3
        default 32
        range 16 96

    config CMCAR_VOICE_CODEC_BOARD
        bool "Use board-specific audio codec (new hardware)"
        default y if IDF_TARGET_ESP32S3
        default n
        help
            关闭时使用现有 ICS43434 I2S 麦克风（输入 only）。
            S3 目标板默认启用 ES7210/ES8311/NS4150B；旧麦克风方案在 C6 上
            保持默认关闭。打开后使用 voice_codec_board.c 的实现。

    config CMCAR_VOICE_I2S_BCLK
        int "Microphone I2S BCLK GPIO"
        default 12 if IDF_TARGET_ESP32S3
        default 18
        range 0 48

    config CMCAR_VOICE_I2S_WS
        int "Microphone I2S WS GPIO"
        default 13 if IDF_TARGET_ESP32S3
        default 19
        range 0 48

    config CMCAR_VOICE_I2S_DIN
        int "Microphone I2S data input GPIO"
        default 14 if IDF_TARGET_ESP32S3
        default 21
        range 0 48

    config CMCAR_VOICE_I2S_RIGHT_CHANNEL
        bool "Read right I2S slot (otherwise left)"
        default n

    config CMCAR_VOICE_BOARD_I2C_SDA
        int "Board codec I2C SDA GPIO"
        depends on CMCAR_VOICE_CODEC_BOARD
        default 8
        range 0 48

    config CMCAR_VOICE_BOARD_I2C_SCL
        int "Board codec I2C SCL GPIO"
        depends on CMCAR_VOICE_CODEC_BOARD
        default 9
        range 0 48

    config CMCAR_VOICE_BOARD_I2S_MCK
        int "Board codec I2S MCLK GPIO"
        depends on CMCAR_VOICE_CODEC_BOARD
        default 15
        range 0 48

    config CMCAR_VOICE_BOARD_I2S_BCLK
        int "Board codec I2S BCLK GPIO"
        depends on CMCAR_VOICE_CODEC_BOARD
        default 16
        range 0 48

    config CMCAR_VOICE_BOARD_I2S_WS
        int "Board codec I2S WS GPIO"
        depends on CMCAR_VOICE_CODEC_BOARD
        default 17
        range 0 48

    config CMCAR_VOICE_BOARD_I2S_DOUT
        int "Board codec I2S DOUT GPIO (to board DI)"
        depends on CMCAR_VOICE_CODEC_BOARD
        default 18
        range 0 48

    config CMCAR_VOICE_BOARD_I2S_DIN
        int "Board codec I2S DIN GPIO (from board DO)"
        depends on CMCAR_VOICE_CODEC_BOARD
        default 21
        range 0 48

    config CMCAR_VOICE_BOARD_PA_GPIO
        int "NS4150B EN GPIO (-1 = hardwired on)"
        depends on CMCAR_VOICE_CODEC_BOARD
        default -1
        range -1 48
        help
            功放使能脚。当前板子 EN 常接 3.3V 时保持 -1；改接 GPIO 后填
            该 GPIO，初始化完成才拉高，关机/复位前拉低，避免爆音。

    config CMCAR_VOICE_BOARD_VOLUME
        int "Default playback volume (0-100)"
        depends on CMCAR_VOICE_CODEC_BOARD
        default 60
        range 0 100

    config CMCAR_VOICE_BOARD_INPUT_GAIN_DB
        int "ES7210 input gain (dB)"
        depends on CMCAR_VOICE_CODEC_BOARD
        default 37
        range 0 48

    config CMCAR_VOICE_BOARD_MIC_CHANNEL
        int "ES7210 TDM channel used as the mono pipeline input"
        depends on CMCAR_VOICE_CODEC_BOARD
        default 0
        range 0 3
        help
            实测 ch0/ch2 为两个麦克风，ch1 为 AEC 参考，ch3 为空。

    config CMCAR_VOICE_AEC
        bool "Enable AFE acoustic echo cancellation with the board reference"
        depends on CMCAR_VOICE_CODEC_BOARD && IDF_TARGET_ESP32S3
        default y if IDF_TARGET_ESP32S3
        default n
        help
            把 ch0（麦克风）与 ch1（功放前参考）按 "MR" 交织送进 AFE 并开启
            AEC。开启后 codec 的 read() 返回 2 通道交织数据。打断（barge-in）
            依赖这个能力，但还需要服务端配合。

    config CMCAR_VOICE_AEC_HIGH_PERF
        bool "Use AFE high-performance mode with AEC"
        depends on CMCAR_VOICE_AEC
        default n
        help
            HIGH_PERF 回声抑制更好，CPU/内存开销更高。

    config CMCAR_VOICE_AEC_FILTER_LENGTH
        int "AEC adaptive filter length"
        depends on CMCAR_VOICE_AEC
        default 8
        range 1 8
        help
            ESP-SR 对 S3 推荐 4；越大收敛越慢但能覆盖更长延迟。

    config CMCAR_VOICE_ENABLED
        bool "Enable voice WebSocket upload"
        default y
        help
            启用 I2S 麦克风采集和 WebSocket 推流。
            运行时在串口输入 s + 回车，录一段音频并上传 pyserver。

    config CMCAR_VOICE_WAKE_ENABLED
        bool "Local nihaoxiaozhi wake, one utterance per wake"
        default y
        help
            Detect locally; no audio upload before wake. Use the board profile
            to select one compatible model. Missing model fails closed.

    config CMCAR_VOICE_WAKE_THRESHOLD
        int "WakeNet detection threshold (milli, 0 = model default)"
        default 500
        range 0 999
        depends on CMCAR_VOICE_WAKE_ENABLED
        help
            模型默认阈值写在 _MODEL_INFO_ 里（当前 wn9l 约 0.597）。调低会提高
            召回率（包括说得很快的情况），同时增加误唤醒；0 表示不改。

    config CMCAR_VOICE_CONTINUOUS
        bool "Continuous PCM upload; server VAD owns utterance boundaries"
        default y
        help
            Keep the connection open while WiFi is available. No RMS trigger or
            fixed five-second windows. Original triggered mode remains available.

    config CMCAR_VOICE_WS_URL
        string "pyserver WebSocket URL"
        default "ws://192.168.31.120:8000/api/v1/voice/stream"
        help
            pyserver 语音端点，必须和 pyserver 在同一局域网。

    config CMCAR_VOICE_RECORD_SECONDS
        int "Record seconds per trigger"
        default 5
        range 1 10
        help
            每次触发上传的录音长度。

    config CMCAR_VOICE_AUTO_LOOP
        bool "Auto-record loop (no serial trigger)"
        default n
        help
            启动后自动循环录音上传，不需要在串口输入 s。
            适合台架/语音识别联调。

    config CMCAR_VOICE_TRIGGER_RMS
        int "Voice activity trigger RMS"
        default 800
        range 200 20000
        help
            麦克风 RMS 超过该值时自动开始一次录音上传，不需要串口命令。

    config CMCAR_VOICE_LOOP_DELAY_SEC
        int "Delay between auto sessions (s)"
        default 8
        range 2 60
        depends on CMCAR_VOICE_AUTO_LOOP

endmenu
```

## CodeMyCar/esp32_project/components/wifi_service/Kconfig
```kconfig
menu "WiFi Configuration"

    config CMCAR_WIFI_SSID
        string "WiFi SSID"
        default "MyRouter"

    config CMCAR_WIFI_PASSWORD
        string "WiFi Password"
        default ""

    config CMCAR_WIFI_MAX_RETRY
        int "Max WiFi retry count (0 = infinite)"
        default 0
        range 0 100
        help
            WiFi 断连后最大重试次数。0 表示无限重试。

    config CMCAR_WIFI_RECONNECT_BASE_MS
        int "Reconnect base delay (ms)"
        default 1000
        range 500 10000
        help
            指数退避重连的基础延迟。

endmenu
```

## CodeMyCar/esp32_project/sdkconfig.defaults
```kconfig
# CodeMyCar ESP32-C6 v2.0 默认配置

# WiFi
CONFIG_CMCAR_WIFI_SSID="Xiaomi_8D22"
CONFIG_CMCAR_WIFI_PASSWORD="13501962513"

# MQTT
CONFIG_CMCAR_MQTT_BROKER_URL="mqtt://192.168.31.120:1883"
CONFIG_CMCAR_MQTT_CLIENT_ID="codemycar_esp32"

# 设备
CONFIG_CMCAR_DEVICE_ID="DEV_1"

# 分区表
CONFIG_PARTITION_TABLE_SINGLE_APP_LARGE=y

# UART ISR in IRAM
CONFIG_UART_ISR_IN_IRAM=y

# 优化级别
CONFIG_COMPILER_OPTIMIZATION_SIZE=y
```
