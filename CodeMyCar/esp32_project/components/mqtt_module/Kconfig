## CodeMyCar/esp32_project/components/mqtt_module/Kconfig
```kconfig
menu "MQTT Configuration"

    config MQTT_BROKER_URL
        string "MQTT Broker URL"
        default "mqtt://localhost"
        help
            URL of the MQTT broker to connect to

    config MQTT_BROKER_PORT
        int "MQTT Broker Port"
        default 1883
        help
            Port of the MQTT broker to connect to

    config MQTT_CLIENT_ID
        string "MQTT Client ID"
        default "esp32_client"
        help
            Client ID used when connecting to the MQTT broker

    config MQTT_USERNAME
        string "MQTT Username"
        default ""
        help
            Username for MQTT authentication (leave blank if not required)

    config MQTT_PASSWORD
        string "MQTT Password"
        default ""
        help
            Password for MQTT authentication (leave blank if not required)

endmenu
```

## CodeMyCar/esp32_project/components/wifi_module/Kconfig
```kconfig
menu "WiFi Configuration"

    config EXAMPLE_WIFI_SSID
        string "WiFi SSID"
        default "MyRouter"
        help
            WiFi接入点的名称(SSID)

    config EXAMPLE_WIFI_PASSWORD
        string "WiFi Password"
        default "my_password"
        help
            WiFi密码（至少8字符）

endmenu
```
